## main/Kconfig.projbuild
```kconfig
menu "WoL Configuration"

    config DESTINATION_MAC_ADDRESS
        string "Destination MAC address"
        default "112233445566"
        help 
            ESP32 wil send WoL packet to the devices that have this MAC address

endmenu
```
